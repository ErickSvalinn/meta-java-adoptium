## conf/layer.conf
```bitbake
# We have a conf and classes directory, append to BBPATH
BBPATH .= ":${LAYERDIR}"

# We have recipes-* directories, add to BBFILES
BBFILES += "${LAYERDIR}/recipes-*/*/*.bb \
            ${LAYERDIR}/recipes-*/*/*.bbappend"

# Add the 'meta-java' collection
BBFILE_COLLECTIONS += "meta-java"
BBFILE_PATTERN_meta-java := "^${LAYERDIR}/"
BBFILE_PRIORITY_meta-java = "10"
LAYERSERIES_COMPAT_meta-java = "mickledore langdale kirkstone dunfell"
LAYERDEPENDS_meta-java = "core"

# Java arm configuration
PREFERRED_PROVIDER_virtual/java-initial-native = "cacao-initial-native"
PREFERRED_PROVIDER_virtual/java-initial = "cacao-initial"
PREFERRED_PROVIDER_virtual/java-native = "cacao-native"
```
